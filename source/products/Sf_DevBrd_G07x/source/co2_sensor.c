#include <string.h>
#include <stdlib.h>
#include <stdint.h>
#include <stdio.h>
#include "sw_common.h"
#include "boardctrl.h"
#include "SerialProc.h"
#include "Rec_Table.h"
#include "App_Api.h"
#include "co2_sensor.h"
#include "main.h" 

co2_sensor_knx_bus_t co2_sensor_knx_bus;

static uint16_t crc_table[256] =
{
    0x0000, 0xc0c1, 0xc181, 0x0140, 0xc301, 0x03c0, 0x0280, 0xc241,
    0xc601, 0x06c0, 0x0780, 0xc741, 0x0500, 0xc5c1, 0xc481, 0x0440,
    0xcc01, 0x0cc0, 0x0d80, 0xcd41, 0x0f00, 0xcfc1, 0xce81, 0x0e40,
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    0x8201, 0x42c0, 0x4380, 0x8341, 0x4100, 0x81c1, 0x8081, 0x4040
};


// Compute CRC-16/MODBUS
uint16_t compute_crc( uint8_t *data, size_t length )
{
    uint16_t crc = CRC_INIT;
    while ( length-- )
    {
        uint8_t tableIndex = ( crc ^ *data++ ) & 0xFF;
        crc = crc_table[tableIndex] ^ ( crc >> 8 );
    }
    return crc; // In some cases, you might want to swap the bytes of the result.
}

static BYTE temp_init[][7] =
{
    {0xFE, 0x2B, 0x0E, 0x04, 0x00, 0x67, 0x33},
    {0xFE, 0x2B, 0x0E, 0x04, 0x01, 0xA6, 0xF3},
    {0xFE, 0x44, 0x00, 0x28, 0x08, 0x06, 0xE2},
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    {0xFE, 0x44, 0x00, 0x92, 0x0A, 0xF4, 0x43}
};

BOOL co2_sensor_init()
{
    static uint8_t dat_init_pos = 0;
    USART_SendStringData( temp_init[dat_init_pos++], 7 );

    if ( dat_init_pos == 22 )
        return TRUE;
    else
        return FALSE;
}


#define TEMP_LEN 1
#define CMD_LEN 8
uint8_t dat_rcv_pos = 0;
static BYTE temp_send[][CMD_LEN] =
{
//    {0xFE, 0x44, 0x00, 0x1F, 0x01, 0xD0, 0xD4},
//    {0xFE, 0x44, 0x00, 0x06, 0x04, 0x1B, 0x47},
//    {0xFE, 0x44, 0x00, 0x0E, 0x02, 0x9C, 0x85},
//    {0xFE, 0x44, 0x00, 0x10, 0x02, 0x95, 0x25},
//    {0xFE, 0x44, 0x00, 0x14, 0x01, 0xD7, 0xE4},
//    {0xFE, 0x44, 0x00, 0x1C, 0x03, 0x51, 0xE5},
//    {0xFE, 0x44, 0x00, 0x28, 0x04, 0x06, 0xE7},
//    {0xFE, 0x44, 0x00, 0x60, 0x01, 0xF0, 0xE4},
//    {0xFE, 0x44, 0x00, 0x69, 0x02, 0xB6, 0xB5},
//    {0xFE, 0x44, 0x00, 0x74, 0x02, 0xBF, 0xE5}
    {0xFE, 0x04, 0x00, 0x03, 0x00, 0x01, 0xD5, 0xC5}
//    {0xFE, 0x04, 0x00, 0x04, 0x00, 0x01, 0xD5, 0xC5}
};
static BYTE temp_rcv[TEMP_LEN][9] = {0};
static void co2_value_request()
{
    USART_SendStringData(temp_send[0], CMD_LEN);
}

static void TaskRun()
{
    co2_value_request();
}

BYTE seneair_rcv_done = 0;
static uint8_t seneairBuff[COMMAND_LEN] = {0};
void seneair_decoder( uint8_t nByte )
{
    static uint8_t pos = 0;
    static uint8_t data_len = 0;
    if ( pos == 0 )
    {
        if ( nByte == 0xfe )
        {
            seneairBuff[pos++] = nByte;
        }
    }
    else if ( pos == 1 )
    {
        if ( nByte == 0x44 || nByte == 0x04 )
        {
            seneairBuff[pos++] = nByte;
        }
        else
        {
            pos = 0;
        }
    }
    else if ( pos == 2 )
    {
        seneairBuff[pos++] = nByte;
        data_len = nByte + 5;
    }
    else
    {
        seneairBuff[pos] = nByte;
        if ( pos < data_len - 1 )
        {
            pos ++;
        }
        else
        {
            pos = 0;
            seneair_rcv_done = 1;
            memcpy( temp_rcv[dat_rcv_pos], seneairBuff, 9 );
            if ( dat_rcv_pos < TEMP_LEN - 1 )
            {
                dat_rcv_pos++;
            }
            else
            {
                dat_rcv_pos = 0;
            }
        }
    }
}


/**
 * @description: EventProcess
 * @param {type}
 * @return: none
 */
static void EventProcess()
{
    if ( seneair_rcv_done )
    {
        WORD16 crc = compute_crc( temp_rcv[0], 3 + * ( temp_rcv[0] + 2 ) );
        if ( ( crc & 0xff ) == *( temp_rcv[0] + * ( temp_rcv[0] + 2 ) + 3 ) && ( crc >> 8 & 0xff ) == *( temp_rcv[0] + * ( temp_rcv[0] + 2 ) + 4 ) )
        {
            co2_sensor_knx_bus.co2_value = (((WORD16)*(temp_rcv[0]+3) << 8) & 0xff00) | ((WORD16)*(temp_rcv[0]+4) & 0xff);
            co2_sensor_knx_bus.co2_valueflag = 1;
        }
        seneair_rcv_done = 0;
        memset( temp_rcv[0], 0, sizeof( temp_rcv[0] ) );
    }
}

/**
 * @description: Main loop of the HMI system and logic control, this function
    should be called per ms.
 * @param {type} receive byte
 * @return: none
 */
void co2_sensor_Loop()
{
    static WORD32 TimesMsRef;

    static BYTE InitFlag = FALSE;
    
    if ( !InitFlag )
    {
        if ( API_KnxTm_GetDelayMs( TimesMsRef ) >= INIT_PERIOD )
        {
            TimesMsRef = API_KnxTm_GetTimeMs();
            InitFlag = co2_sensor_init();
        }
    }
    else
    {
        if ( API_KnxTm_GetDelayMs( TimesMsRef ) >= LOOP_PERIOD )
        {
            TimesMsRef = API_KnxTm_GetTimeMs();

            TaskRun();
            EventProcess();
        }
    }    
}
